## config/boards/shields/flkb/Kconfig.defconfig
```kconfig
# Copyright (c) 2020 The ZMK Contributors
# SPDX-License-Identifier: MIT

if SHIELD_FLKB

config ZMK_KEYBOARD_NAME
    default "FLKB"

endif
```

## config/boards/shields/flkb/Kconfig.shield
```kconfig
# Copyright (c) 2020 The ZMK Contributors
# SPDX-License-Identifier: MIT

config SHIELD_FLKB
    def_bool $(shields_list_contains,flkb)
```
