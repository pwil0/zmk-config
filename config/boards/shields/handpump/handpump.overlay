/*
 * Copyright (c) 2020 The ZMK Contributors
 *
 * SPDX-License-Identifier: MIT
 */

/ {
    chosen {
        zmk,kscan = &kscan0;
    };

    kscan0: kscan_0 {
        compatible = "zmk,kscan-gpio-direct";
        wakeup-source;
        input-gpios
            = <&pro_micro 16 (GPIO_ACTIVE_LOW | GPIO_PULL_UP)> // col 6
            , <&pro_micro 15 (GPIO_ACTIVE_LOW | GPIO_PULL_UP)> // col 8
            , <&pro_micro 14 (GPIO_ACTIVE_LOW | GPIO_PULL_UP)> // col 7
            , <&pro_micro 18 (GPIO_ACTIVE_LOW | GPIO_PULL_UP)> // col 9
            , <&pro_micro 10 (GPIO_ACTIVE_LOW | GPIO_PULL_UP)> // col 5
            , <&pro_micro 9 (GPIO_ACTIVE_LOW | GPIO_PULL_UP)> // col 3
            , <&pro_micro 5 (GPIO_ACTIVE_LOW | GPIO_PULL_UP)> // col 1
            , <&pro_micro 7 (GPIO_ACTIVE_LOW | GPIO_PULL_UP)> // col 2
            , <&pro_micro 6 (GPIO_ACTIVE_LOW | GPIO_PULL_UP)> // col 0
            , <&pro_micro 8 (GPIO_ACTIVE_LOW | GPIO_PULL_UP)> // col 4
            , <&pro_micro 4 (GPIO_ACTIVE_LOW | GPIO_PULL_UP)> // layers
            ;
    };
};
